## meta-anas-edge/conf/layer.conf
```bitbake
# We have a conf and classes directory, add to BBPATH
BBPATH .= ":${LAYERDIR}"

# We have recipes-* directories, add to BBFILES
BBFILES += "${LAYERDIR}/recipes-*/*/*.bb \
            ${LAYERDIR}/recipes-*/*/*.bbappend"

BBFILE_COLLECTIONS += "meta-anas-edge"
BBFILE_PATTERN_meta-anas-edge = "^${LAYERDIR}/"
BBFILE_PRIORITY_meta-anas-edge = "6"

LAYERDEPENDS_meta-anas-edge = "core"
LAYERSERIES_COMPAT_meta-anas-edge = "scarthgap"
```
